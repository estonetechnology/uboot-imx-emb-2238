## board/freescale/imx8mm_iob4607/Kconfig
```kconfig
if TARGET_IMX8MM_IOB4607 || TARGET_IMX8MM_DDR4_EVK

config SYS_BOARD
	default "imx8mm_iob4607"

config SYS_VENDOR
	default "freescale"

config SYS_CONFIG_NAME
	default "imx8mm_iob4607"

source "board/freescale/common/Kconfig"

endif
```

## board/freescale/imx8mm_poe2237/Kconfig
```kconfig
if TARGET_IMX8MM_POE2237 || TARGET_IMX8MM_DDR4_EVK

config SYS_BOARD
	default "imx8mm_poe2237"

config SYS_VENDOR
	default "freescale"

config SYS_CONFIG_NAME
	default "imx8mm_poe2237"

source "board/freescale/common/Kconfig"

endif
```

## board/freescale/imx8mm_ppc4210/Kconfig
```kconfig
if TARGET_IMX8MM_PPC4210 || TARGET_IMX8MM_DDR4_EVK

config SYS_BOARD
	default "imx8mm_ppc4210"

config SYS_VENDOR
	default "freescale"

config SYS_CONFIG_NAME
	default "imx8mm_ppc4210"

source "board/freescale/common/Kconfig"

endif
```

## board/freescale/imx8mm_som2237/Kconfig
```kconfig
if TARGET_IMX8MM_SOM2237 || TARGET_IMX8MM_DDR4_EVK

config SYS_BOARD
	default "imx8mm_som2237"

config SYS_VENDOR
	default "freescale"

config SYS_CONFIG_NAME
	default "imx8mm_som2237"

source "board/freescale/common/Kconfig"

endif
```
